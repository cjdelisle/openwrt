## target/linux/en75/files/arch/mips/en75/Kconfig
```kconfig
# SPDX-License-Identifier: GPL-2.0
if ECONET_EN75

## TODO: MFD_SYSCON dependency of COMMON_CLK_EN75
## TODO: move TIMER_OF, CLKSRC_MMIO to dependencies of EN75_TIMER

choice
	prompt "EcoNet SoC selection"
	default SOC_EN751221
	help
	  Select EcoNet MIPS SoC type.

	config SOC_EN751221
		bool "EN751221 family"
		select SYS_SUPPORTS_BIG_ENDIAN
		select CPU_BIG_ENDIAN
		select EARLY_PRINTK_8250
		select SYS_HAS_EARLY_PRINTK
		select USE_GENERIC_EARLY_PRINTK_8250
		select EN75_K34C_INTC
		select SYS_SUPPORTS_MULTITHREADING
		select GENERIC_IRQ_IPI
		select COMMON_CLK_EN75
		select EN75_TIMER
		select TIMER_OF
		select CLKSRC_MMIO
		select MFD_SYSCON
		select IRQ_MIPS_CPU

		help
		  The EN751221 family includes EN7512, RN7513, EN7521, EN7526.
		  They are based on single core MIPS 34Kc processors.

	config SOC_EN751627
		bool "EN751627 NOT WORKING YET"

		help
		  The EN751627 family includes EN7516, EN7527, EN7528.
		  They are based on dual core MIPS 1004Kc processors.
endchoice

endif
```
